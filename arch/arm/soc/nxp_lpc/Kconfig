## arch/arm/soc/nxp_lpc/Kconfig
```kconfig
#
# Copyright (c) 2017, NXP
#
# SPDX-License-Identifier: Apache-2.0
#

config SOC_FAMILY_LPC
	bool
	# omit prompt to signify a "hidden" option
	default n

if SOC_FAMILY_LPC
config SOC_FAMILY
	string
	default "nxp_lpc"
endif

config LPC17XX_ARM_MPU_ENABLE
	bool "Enable MPU"
	depends on CPU_HAS_MPU
	select ARM_MPU
	default n
	help
	  Enable MPU

source "arch/arm/soc/nxp_lpc/*/Kconfig.soc"

config SOC_PART_NUMBER
	string
	default SOC_PART_NUMBER_LPC54XXX if SOC_SERIES_LPC54XXX
	default SOC_PART_NUMBER_LPC17XX  if SOC_SERIES_LPC17XX

	help
	  This string holds the full part number of the SoC. It is a hidden option
	  that you should not set directly. The part number selection choice defines
	  the default value for this string.
```

## arch/arm/soc/nxp_lpc/lpc17xx/Kconfig.defconfig.series
```kconfig
# Kconfig -  LPC17XX series configuration options
#
# Copyright (c) 2017, NXP
#
# SPDX-License-Identifier: Apache-2.0
#

if SOC_SERIES_LPC17XX

config SOC_SERIES
	default lpc17xx

config NUM_IRQS
	int
	# must be >= the highest interrupt number used
	default 40

source "arch/arm/soc/nxp_lpc/lpc17xx/Kconfig.defconfig.lp*"

endif # SOC_SERIES_LPC17xx
```

## arch/arm/soc/nxp_lpc/lpc17xx/Kconfig.series
```kconfig
# Kconfig - LPC LPC17XX MCU line
#
# Copyright (c) 2017, NXP
#
# SPDX-License-Identifier: Apache-2.0
#

config SOC_SERIES_LPC17XX
	bool "LPC LPC17xx Series MCU"
	select CPU_CORTEX_M
	select CPU_CORTEX_M3
	select SOC_FAMILY_LPC	
	select CPU_HAS_SYSTICK
	help
	  Enable support for LPC LPC17XX MCU series
```

## arch/arm/soc/nxp_lpc/lpc17xx/Kconfig.soc
```kconfig
# Kconfig - LPC LPC54XXX MCU line
#
# Copyright (c) 2017, NXP
#
# SPDX-License-Identifier: Apache-2.0
#

choice
prompt "LPC LPC17XX MCU Selection"
depends on SOC_SERIES_LPC17XX

config SOC_LPC1768
	bool "SOC_LPC1768"
	select HAS_MCUX

endchoice

if SOC_SERIES_LPC17XX

config SOC_PART_NUMBER_LPC1768
	bool

config SOC_PART_NUMBER_LPC17XX
	string
	default "LPC1768" if SOC_PART_NUMBER_LPC1768

	help
	  This string holds the full part number of the SoC. It is a hidden
	  option that you should not set directly. The part number selection
	  choice defines the default value for this string.

endif # SOC_SERIES_LPC17XX
```

## boards/arm/lpc17xx/Kconfig.board
```kconfig
# Kconfig - LPC1768_LANDTIGER board configuration
#
# Copyright (c) 2016 Linaro Limited.
#
# SPDX-License-Identifier: Apache-2.0
#

config BOARD_LPC1768_LANDTIGER
	bool "LPC1768 LANDTIGER Development Board"
	depends on SOC_LPC1768
```

## boards/arm/lpc17xx/Kconfig.defconfig
```kconfig
# Kconfig - STM32F4DISCOVERY board configuration
#
# Copyright (c) 2016 Linaro Limited.
#
# SPDX-License-Identifier: Apache-2.0
#

if BOARD_LPC1768_LANDTIGER

config BOARD
	default lpc1768_landtiger

if UART_CONSOLE

config UART_LPC17xx_PORT_1
	def_bool y

endif # UART_CONSOLE

endif # BOARD_LPC1768_LANDTIGER
```
