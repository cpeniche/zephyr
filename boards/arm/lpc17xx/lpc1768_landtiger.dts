/*
 * Copyright (c) 2017 Linaro Limited
 *
 * SPDX-License-Identifier: Apache-2.0
 */

/dts-v1/;
#include <nxp/nxp_lpc17xx.dtsi>

/ {
	model = "NXP lpc1768 landtiger board";
	compatible = "nxp,lpc1768";

	chosen {
		zephyr,console = &usart0;
		zephyr,sram = &sram0;
		zephyr,flash = &flash0;
	};
};

&usart0 {
	current-speed = <115200>;
	pinctrl-names = "default";
	status = "ok";
};

